#include "dilemma.dtsi"

&default_transform {
	  col-offset = <5>;
};

&kscan0 {
    row-gpios
        = <&pro_micro 19 GPIO_ACTIVE_HIGH> // M_ROW2
        , <&pro_micro 18 GPIO_ACTIVE_HIGH> // M_ROW3
        , <&pro_micro 4 GPIO_ACTIVE_HIGH>  // M_ROW4
        , <&pro_micro 6 GPIO_ACTIVE_HIGH>  // M_ROW1
        ;

    col-gpios
        = <&pro_micro 16 (GPIO_ACTIVE_HIGH | GPIO_PULL_DOWN)> // M_COL1
		    , <&pro_micro 10 (GPIO_ACTIVE_HIGH | GPIO_PULL_DOWN)> // M_COL2
		    , <&pro_micro 14 (GPIO_ACTIVE_HIGH | GPIO_PULL_DOWN)> // M_COL3
		    , <&pro_micro 15 (GPIO_ACTIVE_HIGH | GPIO_PULL_DOWN)> // M_COL4
		    , <&pro_micro 5 (GPIO_ACTIVE_HIGH | GPIO_PULL_DOWN)>  // M_COL5
		    ;
};
