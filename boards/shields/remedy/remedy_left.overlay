#include "remedy.dtsi"

&kscan0 {
    row-gpios
        = <&pro_micro 4 GPIO_ACTIVE_HIGH>  // M_ROW2_L
        , <&pro_micro 5 GPIO_ACTIVE_HIGH>  // M_ROW3_L
        , <&pro_micro 19 GPIO_ACTIVE_HIGH> // M_ROW4_L
        , <&pro_micro 15 GPIO_ACTIVE_HIGH> // M_ROW1_L
        ;

    col-gpios
        = <&pro_micro 8 (GPIO_ACTIVE_HIGH | GPIO_PULL_DOWN)>  // M_COL1_L
		    , <&pro_micro 9 (GPIO_ACTIVE_HIGH | GPIO_PULL_DOWN)>  // M_COL2_L
		    , <&pro_micro 7 (GPIO_ACTIVE_HIGH | GPIO_PULL_DOWN)>  // M_COL3_L
		    , <&pro_micro 6 (GPIO_ACTIVE_HIGH | GPIO_PULL_DOWN)>  // M_COL4_L
		    , <&pro_micro 18 (GPIO_ACTIVE_HIGH | GPIO_PULL_DOWN)> // M_COL5_L
		    ;
};
