## boards/shields/remedy/Kconfig.defconfig
```kconfig
if SHIELD_REMEDY_LEFT

config ZMK_KEYBOARD_NAME
	default "Remedy"

config ZMK_SPLIT_ROLE_CENTRAL
	default y

endif

if SHIELD_REMEDY_RIGHT

config ZMK_KEYBOARD_NAME
	default "Remedy Right"

endif

if SHIELD_REMEDY_LEFT || SHIELD_REMEDY_RIGHT

config ZMK_SPLIT
	default y
	
endif
```

## boards/shields/remedy/Kconfig.shield
```kconfig
config SHIELD_REMEDY_LEFT
	def_bool $(shields_list_contains,remedy_left)

config SHIELD_REMEDY_RIGHT
	def_bool $(shields_list_contains,remedy_right)
```
